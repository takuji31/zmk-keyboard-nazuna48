## boards/shields/nazuna46/Kconfig.defconfig
```kconfig
if SHIELD_NAZUNA46_LEFT

config ZMK_KEYBOARD_NAME
    default "nazuna46"

endif

if SHIELD_NAZUNA46_LEFT || SHIELD_NAZUNA46_RIGHT

config ZMK_SPLIT
    default y

endif
```

## boards/shields/nazuna46/Kconfig.shield
```kconfig
config SHIELD_NAZUNA46_LEFT
    def_bool $(shields_list_contains,nazuna46_left)
config SHIELD_NAZUNA46_RIGHT
    def_bool $(shields_list_contains,nazuna46_right)
```

## boards/shields/nazuna48/Kconfig.defconfig
```kconfig
if SHIELD_NAZUNA48_LEFT || SHIELD_NAZUNA48_DONGLE

config ZMK_KEYBOARD_NAME
    default "nazuna48"

config ZMK_SPLIT_ROLE_CENTRAL
    default y

config ZMK_SPLIT_BLE_CENTRAL_PERIPHERALS
    default 2

config BT_MAX_CONN
    default 7

config BT_MAX_PAIRED
    default 7

endif

if SHIELD_NAZUNA48_LEFT || SHIELD_NAZUNA48_RIGHT || SHIELD_NAZUNA48_DONGLE

config ZMK_SPLIT
    default y

endif
```

## boards/shields/nazuna48/Kconfig.shield
```kconfig
config SHIELD_NAZUNA48_LEFT
    def_bool $(shields_list_contains,nazuna48_left)
config SHIELD_NAZUNA48_RIGHT
    def_bool $(shields_list_contains,nazuna48_right)
config SHIELD_NAZUNA48_DONGLE
    def_bool $(shields_list_contains,nazuna48_dongle)
```
